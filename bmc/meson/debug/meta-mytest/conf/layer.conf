## bmc/meson/debug/meta-mytest/conf/layer.conf
```bitbake
BBPATH .= ":${LAYERDIR}"

# 告訴 BitBake 去哪些路徑找 .bb / .bbappend
BBFILES += "\
  ${LAYERDIR}/recipes-*/*/*.bb \
  ${LAYERDIR}/recipes-*/*/*.bbappend \
"

BBFILE_COLLECTIONS += "evb"
# 用正則把這個 layer 底下的檔案都納入
BBFILE_PATTERN_evb = "^${LAYERDIR}/"

# 依你的 Yocto 版本調整
LAYERSERIES_COMPAT_evb = "scarthgap walnascar"
```
